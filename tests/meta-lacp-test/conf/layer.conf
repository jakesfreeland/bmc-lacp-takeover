## tests/meta-lacp-test/conf/layer.conf
```bitbake
BBPATH .= ":${LAYERDIR}"
BBFILES += "${LAYERDIR}/recipes-*/*/*.bb ${LAYERDIR}/recipes-*/*/*.bbappend"
BBFILE_COLLECTIONS += "lacp-test"
BBFILE_PATTERN_lacp-test = "^${LAYERDIR}/"
BBFILE_PRIORITY_lacp-test = "20"
LAYERSERIES_COMPAT_lacp-test = "wrynose blacksail"
```
